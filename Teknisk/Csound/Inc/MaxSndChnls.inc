; Initiate channels for sending data to csound~ in Max

; Declare channels that will be sent to Max
prints		"Declaring channels\n"
			chn_k			"azi1", 3
			chn_k			"azi2", 3
			chn_k			"azi3", 3
			chn_k			"azi4", 3
			chn_k			"azi5", 3
			chn_k			"azi6", 3
			chn_k			"azi7", 3
			chn_k			"azi8", 3

			chn_k			"ele1", 3
			chn_k			"ele2", 3
			chn_k			"ele3", 3
			chn_k			"ele4", 3
			chn_k			"ele5", 3
			chn_k			"ele6", 3
			chn_k			"ele7", 3
			chn_k			"ele8", 3

			chn_k			"distance1", 3
			chn_k			"distance2", 3
			chn_k			"distance3", 3
			chn_k			"distance4", 3
			chn_k			"distance5", 3
			chn_k			"distance6", 3
			chn_k			"distance7", 3
			chn_k			"distance8", 3
;
;			chn_k			"x7", 2
;			chn_k			"y7", 2
;			chn_k			"z7", 2
;			chn_k			"x8", 2
;			chn_k			"y8", 2
;			chn_k			"z8", 2

			chn_k			"spread1", 3
			chn_k			"spread2", 3
			chn_k			"spread3", 3
			chn_k			"spread4", 3
			chn_k			"spread5", 3
			chn_k			"spread6", 3
			chn_k			"spread7", 3
			chn_k			"spread8", 3

			chn_k			"reverberance1", 3
			chn_k			"reverberance2", 3

